## arch/arm/core/cortex_a/Kconfig
```kconfig
# Kconfig - ARM Cortex-A platform configuration options

#
# Copyright (c) 2017 Broadcom Limited
#
# SPDX-License-Identifier: Apache-2.0
#

config ISA_THUMB2
	bool
	# Omit prompt to signify "hidden" option
	default n
	help
	From: http://www.arm.com/products/processors/technologies/instruction-set-architectures.php

	Thumb-2 technology is the instruction set underlying the ARM Cortex
	architecture which provides enhanced levels of performance, energy
	efficiency, and code density for a wide range of embedded
	applications.

	Thumb-2 technology builds on the success of Thumb, the innovative
	high code density instruction set for ARM microprocessor cores, to
	increase the power of the ARM microprocessor core available to
	developers of low cost, high performance systems.

	The technology is backwards compatible with existing ARM and Thumb
	solutions, while significantly extending the features available to
	the Thumb instructions set. This allows more of the application to
	benefit from the best in class code density of Thumb.

	For performance optimized code Thumb-2 technology uses 31 percent
	less memory to reduce system cost, while providing up to 38 percent
	higher performance than existing high density code, which can be used
	to prolong battery-life or to enrich the product feature set. Thumb-2
	technology is featured in the  processor, and in all ARMv7
	architecture-based processors.

config ARMV7_A
	bool
	# Omit prompt to signify "hidden" option
	default n
	select ISA_THUMB2
	select ATOMIC_OPERATIONS_C if ATOMIC_OPERATIONS_BUILTIN != y
	help
	This option signifies the use of an ARMv7-A processor implementation.

config ARM_GIC_400
	bool
	# Omit prompt to signify "hidden" option
	default n
	help
	This option signifies the use of ARM Generic Interrupt Controller

config GIC_INIT_PRIORITY
	int
	# Omit prompt to signify "hidden" option
	default 0
	depends on ARM_GIC_400
	help
	GIC Interrupt driver priority

config CPU_CORTEX_A7
	bool
	# Omit prompt to signify "hidden" option
	select ARMV7_A
	default n
	help
	This option signifies the use of a Cortex-A7 CPU

config BOOT_LOADER_IN_ARM_STATE
	bool
	# Omit prompt to signify "hidden" option
	default n
	help
	This option should be enabled if the system has a boot loader that
	was built without the -mthumb option.

menu "ARM Cortex-A options"
	depends on CPU_CORTEX_A

config DATA_ENDIANNESS_LITTLE
	bool
	default y
	help
	This is driven by the processor implementation, since it is fixed in
	hardware. The board should set this value to 'n' if the data is
	implemented as big endian.

config STACK_ALIGN_DOUBLE_WORD
	bool
	prompt "Align stacks on double-words (8 octets)"
	default y
	help
	This is needed to conform to AAPCS, the procedure call standard for
	the ARM. It wastes stack space.

config FAULT_DUMP
	int
	prompt "Fault dump level"
	default 2
	range 0 2
	help
	Different levels for display information when a fault occurs.

	2: The default. Display specific and verbose information. Consumes
		the most memory (long strings).

	1: Display general and short information. Consumes less memory
		(short strings).

	0: Off.

config STACK_DUMP_SIZE_ON_FAULT
	int
	prompt "Amount of stack to dump on a fault"
	default 0
	help
	When set to non-zero the fault handler dumps the stack data
	from the mode that caused the fault. Set to 0 to disable.

config XIP
	default y
endmenu

menu "ARM Cortex-A7 options"
	depends on ARMV7_A

config LDREX_STREX_AVAILABLE
	bool
	default n
	depends on ARM_CORE_MMU

config ARM_CORE_MMU
	bool "ARM Core MMU functionalities"
	select LDREX_STREX_AVAILABLE
	select ATOMIC_OPERATIONS_BUILTIN
	default n
	help
	  ARM Core MMU functionalities

config DATA_CACHE_SUPPORT
	bool "Enable Arm Data cache"
	depends on ARM_CORE_MMU
	default n
	help
	  Enable ARM Data Cache and include cache maintenance apis to build

config IRQ_OFFLOAD
	bool "Enable IRQ offload"
	default n
	help
	Enable irq_offload() API which allows functions to be synchronously
	run in interrupt context. Adds some overhead to context switching.
	Mainly useful for test cases.

config GEN_ISR_TABLES
	default y

config ARCH_HAS_THREAD_ABORT
	bool
	# omit prompt to signify a "hidden" option
	default y

endmenu
```

## boards/arm/citadel_svk_58201/Kconfig
```kconfig
# Kconfig - Citadel SVK 58201 configuration
#
# Copyright (c) 2017 Broadcom Limited
#
# SPDX-License-Identifier: Apache-2.0

if BOARD_CITADEL_SVK_58201

config SOC_UNPROGRAMMED
	bool "Generate code for unprogrammed parts"
	default n

config EXTRA_ROM_CODE_OFFSET
	hex "Additional offset to the image load address start (For extra image headers)"
	default 0

endif
```

## boards/arm/citadel_svk_58201/Kconfig.board
```kconfig
# Kconfig - Citadel SVK for 58201 Configuration
#
# Copyright (c) 2017 Broadcom Limited.
#
# SPDX-License-Identifier: Apache-2.0

config BOARD_CITADEL_SVK_58201
	bool "Citadel SVK 58201"
	depends on SOC_BCM5820X
```

## boards/arm/citadel_svk_58202/Kconfig
```kconfig
# Kconfig - Citadel SVK 58202 configuration
#
# Copyright (c) 2017 Broadcom Limited
#
# SPDX-License-Identifier: Apache-2.0

if BOARD_CITADEL_SVK_58202

config SOC_UNPROGRAMMED
	bool "Generate code for unprogrammed parts"
	default n

endif
```

## boards/arm/citadel_svk_58202/Kconfig.board
```kconfig
# Kconfig - Citadel SVK for 58202 Configuration
#
# Copyright (c) 2017 Broadcom Limited.
#
# SPDX-License-Identifier: Apache-2.0

config BOARD_CITADEL_SVK_58202
	bool "Citadel SVK 58202"
	depends on SOC_BCM5820X
```

## boards/arm/citadel_svk_58202/Kconfig.defconfig
```kconfig
# Kconfig - Citadel SVK 58202 board configuration
#
# Copyright (c) 2017 Broadcom Limited
#
# SPDX-License-Identifier: Apache-2.0

if BOARD_CITADEL_SVK_58202

config BOARD
	default "citadel_svk_58202"

if UART_NS16550

config UART_NS16550_PORT_0
	def_bool y

if UART_NS16550_PORT_0

config UART_NS16550_PORT_0_NAME
	string
	default "UART_0"
config UART_NS16550_PORT_0_IRQ_PRI
	int
	default 0
config UART_NS16550_PORT_0_BAUD_RATE
	int
	default 115200
config UART_NS16550_PORT_0_OPTIONS
	int
	default 0

endif # UART_NS16550_PORT_0

config UART_NS16550_PORT_1
	def_bool n

if UART_NS16550_PORT_1

config UART_NS16550_PORT_1_NAME
	string
	default "UART_1"
config UART_NS16550_PORT_1_IRQ_PRI
	int
	default 0
config UART_NS16550_PORT_1_BAUD_RATE
	int
	default 9600
config UART_NS16550_PORT_1_OPTIONS
	int
	default 0

endif # UART_NS16550_PORT_1

config UART_NS16550_PORT_2
	def_bool n

if UART_NS16550_PORT_2

config UART_NS16550_PORT_2_NAME
	string
	default "UART_2"
config UART_NS16550_PORT_2_IRQ_PRI
	int
	default 0
config UART_NS16550_PORT_2_BAUD_RATE
	int
	default 9600
config UART_NS16550_PORT_2_OPTIONS
	int
	default 0

endif # UART_NS16550_PORT_2

config UART_NS16550_PORT_3
	def_bool n

if UART_NS16550_PORT_3

config UART_NS16550_PORT_3_NAME
	string
	default "UART_3"
config UART_NS16550_PORT_3_IRQ_PRI
	int
	default 0
config UART_NS16550_PORT_3_BAUD_RATE
	int
	default 9600
config UART_NS16550_PORT_3_OPTIONS
	int
	default 0

endif # UART_NS16550_PORT_3

endif # UART_NS16550

if BRCM_DRIVER_DMA

config DMA_IRQ_PRI
	int
	default 0

endif

# Add any uart pin routing and other configurations here
# Example below.
#if UART_BCM5820X
#
#config UART_BCM5820X_GPIO_TX_PIN
#	default 9
#
#config UART_BCM5820X_GPIO_RX_PIN
#	default 11
#
#endif # UART_BCM5820X

endif # BOARD_CITADEL_SVK_58202
```

## boards/arm/citadel_svk_58202/citadel_svk_58202_defconfig
```kconfig
CONFIG_ARM=y
# CONFIG_GEN_IRQ_VECTOR_TABLE is not set
CONFIG_FLOAT=y
CONFIG_SOC_BCM5820X=y
CONFIG_SYS_CLOCK_HW_CYCLES_PER_SEC=26000000
CONFIG_BOARD_CITADEL_SVK_58202=y
CONFIG_BOOT_BANNER=y
CONFIG_HEAP_MEM_POOL_SIZE=65536
CONFIG_SYS_CLOCK_TICKS_PER_SEC=1000
CONFIG_INIT_STACKS=y
CONFIG_CONSOLE=y
CONFIG_CONSOLE_SUBSYS=y
CONFIG_CONSOLE_GETCHAR=y
CONFIG_UART_CONSOLE=y
CONFIG_UART_CONSOLE_DEBUG_SERVER_HOOKS=y
CONFIG_SERIAL=y
CONFIG_UART_LINE_CTRL=y
CONFIG_UART_DRV_CMD=y
CONFIG_UART_NS16550=y
CONFIG_BRCM_DRIVER_BBL=y
CONFIG_BRCM_DRIVER_CRYPTO=y
CONFIG_BRCM_DRIVER_DMA=y
CONFIG_BRCM_DRIVER_DMU=y
CONFIG_BRCM_DRIVER_GPIO=y
CONFIG_BRCM_DRIVER_I2C=y
CONFIG_BRCM_DRIVER_PM=y
CONFIG_BRCM_DRIVER_QSPI=y
CONFIG_BRCM_DRIVER_RTC=y
CONFIG_BRCM_DRIVER_SCC=y
CONFIG_BRCM_DRIVER_SMAU=y
CONFIG_BRCM_DRIVER_SOTP=y
CONFIG_BRCM_DRIVER_SPI=y
CONFIG_SPI4_ENABLE=n
CONFIG_SPI2_USES_MFIO_10_TO_13=y
CONFIG_BRCM_DRIVER_TIMERS=y
CONFIG_OBJECT_TRACING=y
CONFIG_LOG=y
CONFIG_LOG_IMMEDIATE=y
CONFIG_LOG_DEFAULT_LEVEL=2
CONFIG_SHELL=y
CONFIG_SHELL_STACK_SIZE=2500
CONFIG_KERNEL_SHELL=y
CONFIG_ZTEST=y
CONFIG_TEST_EXTRA_STACKSIZE=24000
```

## boards/arm/serp_cp/Kconfig
```kconfig
# Kconfig - Citadel SVK 58201 configuration
#
# Copyright (c) 2017 Broadcom Limited
#
# SPDX-License-Identifier: Apache-2.0

if BOARD_SERP_CP

config SOC_UNPROGRAMMED
	bool "Generate code for unprogrammed parts"
	default n

endif
```

## boards/arm/serp_cp/Kconfig.board
```kconfig
# Kconfig - Citadel SVK for 58201 Configuration
#
# Copyright (c) 2017 Broadcom Limited.
#
# SPDX-License-Identifier: Apache-2.0

config BOARD_SERP_CP
	bool "Citadel Secure Evaluation Reference Platform"
	depends on SOC_BCM5820X
```

## boards/arm/serp_cp/Kconfig.defconfig
```kconfig
# Kconfig - Citadel SVK 58201 board configuration
#
# Copyright (c) 2017 Broadcom Limited
#
# SPDX-License-Identifier: Apache-2.0

if BOARD_SERP_CP

config BOARD
	default "serp_cp"

config LCD_SPI_PORT
	string
	default "spi4"

config SPI4_ENABLE
	def_bool y

config SPI1_USES_MFIO_6_TO_9
	def_bool n

config SPI2_USES_MFIO_10_TO_13
	def_bool n

config SPI3_USES_MFIO_14_TO_17
	def_bool n

config SPI4_USES_MFIO_18_TO_21
	def_bool n

config CAM_I2C_PORT
	int
	default 0

if UART_NS16550

config UART_NS16550_PORT_0
	def_bool y

if UART_NS16550_PORT_0

config UART_NS16550_PORT_0_NAME
	string
	default "UART_0"
config UART_NS16550_PORT_0_IRQ_PRI
	int
	default 0
config UART_NS16550_PORT_0_BAUD_RATE
	int
	default 115200
config UART_NS16550_PORT_0_OPTIONS
	int
	default 0

endif # UART_NS16550_PORT_0

config UART_NS16550_PORT_1
	def_bool n

if UART_NS16550_PORT_1

config UART_NS16550_PORT_1_NAME
	string
	default "UART_1"
config UART_NS16550_PORT_1_IRQ_PRI
	int
	default 0
config UART_NS16550_PORT_1_BAUD_RATE
	int
	default 9600
config UART_NS16550_PORT_1_OPTIONS
	int
	default 0

endif # UART_NS16550_PORT_1

config UART_NS16550_PORT_2
	def_bool n

if UART_NS16550_PORT_2

config UART_NS16550_PORT_2_NAME
	string
	default "UART_2"
config UART_NS16550_PORT_2_IRQ_PRI
	int
	default 0
config UART_NS16550_PORT_2_BAUD_RATE
	int
	default 9600
config UART_NS16550_PORT_2_OPTIONS
	int
	default 0

endif # UART_NS16550_PORT_2

config UART_NS16550_PORT_3
	def_bool n

if UART_NS16550_PORT_3

config UART_NS16550_PORT_3_NAME
	string
	default "UART_3"
config UART_NS16550_PORT_3_IRQ_PRI
	int
	default 0
config UART_NS16550_PORT_3_BAUD_RATE
	int
	default 9600
config UART_NS16550_PORT_3_OPTIONS
	int
	default 0

endif # UART_NS16550_PORT_3

endif # UART_NS16550

if BRCM_DRIVER_DMA

config DMA_IRQ_PRI
	int
	default 0

endif

# Add any uart pin routing and other configurations here
# Example below.
#if UART_BCM5820X
#
#config UART_BCM5820X_GPIO_TX_PIN
#	default 9
#
#config UART_BCM5820X_GPIO_RX_PIN
#	default 11
#
#endif # UART_BCM5820X

endif # BOARD_CITADEL_SVK_58201
```

## boards/arm/serp_cp/serp_cp_defconfig
```kconfig
CONFIG_ARM=y
# CONFIG_GEN_IRQ_VECTOR_TABLE is not set
CONFIG_FLOAT=y
CONFIG_SOC_BCM5820X=y
CONFIG_SYS_CLOCK_HW_CYCLES_PER_SEC=26000000
CONFIG_BOARD_SERP_CP=y
CONFIG_BOOT_BANNER=y
CONFIG_HEAP_MEM_POOL_SIZE=98304
CONFIG_SYS_CLOCK_TICKS_PER_SEC=1000
CONFIG_INIT_STACKS=y
CONFIG_CONSOLE=y
CONFIG_CONSOLE_SUBSYS=y
CONFIG_CONSOLE_GETCHAR=y
CONFIG_UART_CONSOLE=y
CONFIG_UART_CONSOLE_DEBUG_SERVER_HOOKS=y
CONFIG_SERIAL=y
CONFIG_UART_LINE_CTRL=y
CONFIG_UART_DRV_CMD=y
CONFIG_UART_NS16550=y
CONFIG_BRCM_DRIVER_ADC=y
CONFIG_BRCM_DRIVER_BBL=y
CONFIG_BRCM_DRIVER_CRYPTO=y
CONFIG_BRCM_DRIVER_DMA=y
CONFIG_BRCM_DRIVER_DMU=y
CONFIG_BRCM_DRIVER_GPIO=y
CONFIG_BRCM_DRIVER_I2C=y
CONFIG_BRCM_DRIVER_PM=y
CONFIG_BRCM_DRIVER_PWM=y
CONFIG_BRCM_DRIVER_QSPI=y
CONFIG_BRCM_DRIVER_RTC=y
CONFIG_BRCM_DRIVER_SCC=y
CONFIG_BRCM_DRIVER_SMAU=y
CONFIG_BRCM_DRIVER_SOTP=y
CONFIG_BRCM_DRIVER_SPI=y
CONFIG_BRCM_DRIVER_LCD=y
CONFIG_ALLOW_IOMUX_OVERRIDE=y
CONFIG_LCD_SPI_MODE=y
CONFIG_SPI1_USES_MFIO_6_TO_9=n
CONFIG_SPI2_USES_MFIO_10_TO_13=n
CONFIG_SPI3_USES_MFIO_14_TO_17=n
CONFIG_SPI4_USES_MFIO_18_TO_21=n
CONFIG_BRCM_DRIVER_TIMERS=y
CONFIG_BRCM_DRIVER_UNICAM=y
CONFIG_BRCM_DRIVER_USBD=y
CONFIG_BRCM_DRIVER_USBH=y
CONFIG_BRCM_DRIVER_WDT=y
CONFIG_OBJECT_TRACING=y
CONFIG_LOG=y
CONFIG_LOG_IMMEDIATE=y
CONFIG_LOG_DEFAULT_LEVEL=2
CONFIG_SHELL=y
CONFIG_SHELL_STACK_SIZE=2500
CONFIG_KERNEL_SHELL=y
CONFIG_ZBAR=y
CONFIG_ZBAR_USE_STATIC_BUFFER=y
CONFIG_ZBAR_STATIC_TEST=y
CONFIG_ZTEST=y
CONFIG_TEST_EXTRA_STACKSIZE=30000
CONFIG_LCD_SPI_DEV="spi4"
CONFIG_LCD_SPI_MODE_DC_GPIO=53
CONFIG_USB_CDC_ACM=y
CONFIG_USB_DEVICE_VID=0x8086
CONFIG_USB_DEVICE_PID=0xF8A1
```

## driver_mpos_2.1.1/drivers/broadcom/gpio/Kconfig
```kconfig
# Kconfig - BRCM GPIO drvier configuration options

#
# Copyright (c) 2019 Broadcom
#
# SPDX-License-Identifier: Apache-2.0
#

#
# BRCM GPIO driver options
#

config AON_GPIO_INTERRUPT_SUPPORT
	bool "AON GPIO INTERRUPT"
	depends on BRCM_DRIVER_GPIO && BRCM_DRIVER_PM
	default n
	help
		This flag enables AON gpio interrupt support
```

## driver_mpos_2.1.1/drivers/broadcom/qspi_flash/Kconfig
```kconfig
# Kconfig - BRCM QSPI flash drvier configuration options

#
# Copyright (c) 2018 Broadcom Inc.
#
# SPDX-License-Identifier: Apache-2.0
#

#
# BRCM QSPI flash driver options
#

config USE_BSPI_FOR_READ
	bool
	# Omit prompt to signify "hidden" option
	default y
	depends on BRCM_DRIVER_QSPI
	help
		Enable BSPI Memory mapped access for flash read

config USE_WSPI_FOR_WRITE
	bool
	# Omit prompt to signify "hidden" option
	default y
	depends on BRCM_DRIVER_QSPI
	help
		Enable WSPI Memory mapped access for flash write

config USE_CPU_MEMCPY_FOR_WRITE
	bool
	# Omit prompt to signify "hidden" option
	default y
	depends on BRCM_DRIVER_QSPI
	help
		Enable optimized assembly version of memcpy for flash writes

config ENABLE_CACHE_INVAL_ON_WRITE
	bool
	# Omit prompt to signify "hidden" option
	default y
	depends on BRCM_DRIVER_QSPI
	help
		Enable cache invalidation on flash writes

config QSPI_QUAD_IO_ENABLED
	bool
	# Omit prompt to signify "hidden" option
	default y
	depends on BRCM_DRIVER_QSPI
	help
		Enable Quad lane flash access

config SECONDARY_FLASH
	bool
	# Omit prompt to signify "hidden" option
	default y
	depends on BRCM_DRIVER_QSPI
	help
		Enable flash @CS1

config SEC_FLASH_CLOCK_FREQUENCY
	int
	# Omit prompt to signify "hidden" option
	default 25000000
	depends on SECONDARY_FLASH
	help
		Sets the clock frequency for the secondary flash @CS1
```

## driver_mpos_2.1.1/drivers/broadcom/sdio/Kconfig
```kconfig
# Kconfig - BRCM SDIO driver configuration options

#
# Copyright (c) 2019 Broadcom Inc.
#
# SPDX-License-Identifier: Apache-2.0
#

#
# BRCM SDIO driver options
#

config SDIO_DMA_MODE
	bool "Enable DMA mode for SD transfers"
	default y
	depends on BRCM_DRIVER_SDIO
	help
		Enable DMA mode for SD data transfers
```
