## driver_mpos_2.1.1/drivers/broadcom/spi/Kconfig
```kconfig
# Kconfig - BRCM SPI drvier configuration options

#
# Copyright (c) 2018 Broadcom Inc.
#
# SPDX-License-Identifier: Apache-2.0
#

#
# BRCM SPI driver options
#

config SPI_DMA_MODE
	bool "Enable DMA mode for SPI transfers"
	default y
	depends on BRCM_DRIVER_SPI
	help
		Enable DMA mode for SPI data transfers

config SPI1_ENABLE
	bool "Enabled SPI 1 interface"
	default y
	depends on BRCM_DRIVER_SPI
	help
		Enable SPI1 interface

config SPI1_USES_MFIO_6_TO_9
	bool "Route SPI signals to MFIO 6 .. 9"
	default y
	depends on SPI1_ENABLE
	help
		This flag enables SPI1 interface to be routed to
		MFIO pins 6 - 9. With this flag disable they
		are routed to MFIO pins 53 - 56.

config SPI2_ENABLE
	bool "Enabled SPI 2 interface"
	default y
	depends on BRCM_DRIVER_SPI
	help
		Enable SPI2 interface

config SPI2_USES_MFIO_10_TO_13
	bool "Route SPI signals to MFIO 10 .. 13"
	default y
	depends on SPI2_ENABLE
	help
		This flag enables SPI2 interface to be routed to
		MFIO pins 10 - 13. With this flag disable they
		are routed to MFIO pins 57 - 60.

config SPI3_ENABLE
	bool "Enabled SPI 3 interface"
	default y
	depends on BRCM_DRIVER_SPI
	help
		Enable SPI3 interface

config SPI3_USES_MFIO_14_TO_17
	bool "Route SPI signals to MFIO 14 .. 17"
	default y
	depends on SPI3_ENABLE
	help
		This flag enables SPI3 interface to be routed to
		MFIO pins 14 - 17. With this flag disable they
		are routed to MFIO pins 61 - 64.

config SPI4_ENABLE
	bool "Enabled SPI 4 interface"
	default y
	depends on BRCM_DRIVER_SPI
	help
		Enable SPI4 interface

config SPI4_USES_MFIO_18_TO_21
	bool "Route SPI signals to MFIO 18 .. 21"
	default y
	depends on SPI4_ENABLE
	help
		This flag enables SPI4 interface to be routed to
		MFIO pins 18 - 21. With this flag disable they
		are routed to MFIO pins 65 - 68.

config SPI5_ENABLE
	bool "Enabled SPI 5 interface"
	default y
	depends on BRCM_DRIVER_SPI
	help
		Enable SPI5 interface
```

## drivers/broadcom/Kconfig
```kconfig
# Kconfig - BRCM drvier configuration options

#
# Copyright (c) 2018 Broadcom Inc.
#
# SPDX-License-Identifier: Apache-2.0
#

#
# BRCM Driver options
#
menuconfig BRCM
	bool
	prompt "BRCM Drivers"
	default y
	help
	  Enable BRCM Driver

if BRCM

config BRCM_DRIVER_ADC
	bool "Enable BRCM ADC driver"
	default n
	help
	  Enable BRCM ADC driver

config BRCM_DRIVER_BBL
	bool "Enable BRCM BBL driver"
	default n
	help
	  Enable BRCM BBL driver

config BRCM_DRIVER_CRYPTO
	bool "Enable BRCM CRYPTO driver"
	default n
	help
	  Enable BRCM CRYPTO driver

if BRCM_DRIVER_CRYPTO
source "drivers/broadcom/crypto/Kconfig"
endif

config BRCM_DRIVER_DMA
	bool "Enable BRCM DMA driver"
	default n
	help
	  Enable BRCM DMA driver

config BRCM_DRIVER_DMU
	bool "Enable BRCM DMU driver"
	default n
	help
	  Enable BRCM DMU driver

config BRCM_DRIVER_FT
	bool "Enable BRCM FT driver"
	default n
	help
	  Enable BRCM FT driver

config BRCM_DRIVER_GPIO
	bool "Enable BRCM GPIO driver"
	default n
	help
	  Enable BRCM GPIO driver

if BRCM_DRIVER_GPIO
source "drivers/broadcom/gpio/Kconfig"
endif

config BRCM_DRIVER_I2C
	bool "Enable BRCM I2C driver"
	default n
	help
	  Enable BRCM I2C driver

config BRCM_DRIVER_KEYPAD
	bool "Enable BRCM KEYPAD driver"
	default n
	help
	  Enable BRCM KEYPAD driver

config BRCM_DRIVER_MSR
	bool "Enable BRCM MSR driver"
	default n
	help
	  Enable BRCM MSR driver

config BRCM_DRIVER_LCD
	bool "Enable BRCM LCD driver"
	default n
	help
	  Enable BRCM LCD driver

if BRCM_DRIVER_LCD
source "drivers/broadcom/lcd/Kconfig"
endif

source "drivers/broadcom/pinmux/Kconfig"

config BRCM_DRIVER_PM
	bool "Enable BRCM PM driver"
	default n
	help
	  Enable BRCM PM driver

config BRCM_DRIVER_PRINTER
	bool "Enable BRCM PRINTER driver"
	default n
	help
	  Enable BRCM printer driver

config BRCM_DRIVER_PWM
	bool "Enable BRCM PWM driver"
	default n
	help
	  Enable BRCM PWM driver

config BRCM_DRIVER_QSPI
	bool "Enable BRCM QSPI driver"
	default n
	help
	  Enable BRCM QSPI driver

if BRCM_DRIVER_QSPI
source "drivers/broadcom/qspi_flash/Kconfig"
endif

config BRCM_DRIVER_RTC
	bool "Enable BRCM RTC driver"
	default n
	help
	  Enable BRCM RTC driver

config BRCM_DRIVER_SCC
	bool "Enable BRCM Smart card driver"
	default n
	help
	  Enable BRCM Smart card driver

if BRCM_DRIVER_SCC
source "drivers/broadcom/sc/Kconfig"
endif

config BRCM_DRIVER_SDIO
	bool "Enable BRCM SDIO driver"
	default n
	help
	  Enable BRCM SDIO driver

if BRCM_DRIVER_SDIO
source "drivers/broadcom/sdio/Kconfig"
endif

config BRCM_DRIVER_SMAU
	bool "Enable BRCM SMAU driver"
	default n
	help
	  Enable BRCM SMAU driver

if BRCM_DRIVER_SMAU
source "drivers/broadcom/smau/Kconfig"
endif

config BRCM_DRIVER_SMC
	bool "Enable BRCM SMC driver"
	default n
	select SPI1_USES_MFIO_6_TO_9
	select SPI2_USES_MFIO_10_TO_13
	select SPI3_USES_MFIO_14_TO_17
	select SPI4_USES_MFIO_18_TO_21
	help
	  Enable BRCM SMC driver

config BRCM_DRIVER_SOTP
	bool "Enable BRCM SOTP driver"
	default n
	help
	  Enable BRCM SOTP driver

config BRCM_DRIVER_SPI
	bool "Enable BRCM SPI driver"
	default n
	help
	  Enable BRCM SPI driver

if BRCM_DRIVER_SPI
source "drivers/broadcom/spi/Kconfig"
endif

config BRCM_DRIVER_SPL
	bool "Enable BRCM SPL driver"
	default n
	help
	  Enable BRCM SPL driver

config BRCM_DRIVER_TIMERS
	bool "Enable BRCM Timer driver"
	default n
	help
	  Enable BRCM Timer driver

config BRCM_DRIVER_UNICAM
	bool "Enable BRCM Unicam driver"
	default n
	help
	  Enable BRCM Unicam driver

if BRCM_DRIVER_UNICAM
source "drivers/broadcom/unicam/Kconfig"
endif

config BRCM_DRIVER_USBH
	bool "Enable BRCM USB Host driver"
	default n
	help
	  Enable BRCM USB Host driver

config BRCM_DRIVER_USBD
	bool "Enable BRCM USB Device Controller Driver"
	default n
	select USB
	select USB_DEVICE_DRIVER
	select USB_DEVICE_STACK
	help
	  Enable BRCM USB Device Controller Driver

config BRCM_DRIVER_WDT
	bool "Enable BRCM Watchdog Timer driver"
	default n
	help
	  Enable BRCM BRCM Watchdog Timer driver

if BRCM_DRIVER_USBD
source "drivers/broadcom/usbd/Kconfig"
endif

endif # BRCM
```

## drivers/broadcom/crypto/Kconfig
```kconfig
# Kconfig - BRCM CRYPTO drvier configuration options

#
# Copyright (c) 2018 Broadcom Inc.
#
# SPDX-License-Identifier: Apache-2.0
#

#
# BRCM crypto driver options
#

config CRYPTO_DPA
	bool "DPA"
	default y
	depends on BRCM_DRIVER_CRYPTO
	help
		This flag enables DPA

config CRYPTO_BRCM_MBEDTLS
	bool "BRCM MBEDTLS support"
	default n
	depends on BRCM_DRIVER_CRYPTO && MBEDTLS
	help
		This flag enables BRCM mbedtls support
```

## drivers/broadcom/lcd/Kconfig
```kconfig
# Kconfig - BRCM LCD driver configuration options

#
# Copyright (c) 2018 Broadcom Inc.
#
# SPDX-License-Identifier: Apache-2.0
#

#
# BRCM LCD driver options
#

config LCD_SPI_MODE
	bool "Enable SPI mode for LCD"
	default n
	depends on BRCM_DRIVER_LCD
	help
		This flag enables LCD in SPI (serial) mode. If this
		flag is not enabled, LCD will be configured to work
		in Parallel (8-bit) mode usinge SMC interface.

if LCD_SPI_MODE
config LCD_SPI_DEV
	string "LCD SPI Dev interface"
	default "spi1"
	help
		Select the SPI interface used for LCD.

config LCD_SPI_MODE_DC_GPIO
	int "GPIO pin used for data/command selection in SPI mode"
	default 2
	help
		Select the GPIO used for data/command selection
		on the LCD in SPI mode
endif

config LCD_8080_MODE_DC_GPIO
	int "GPIO pin used for data/command selection in 8080 mode"
	default 12
	depends on BRCM_DRIVER_LCD
	help
		Select the GPIO used for data/command selection
		on the LCD in parallel mode
```

## drivers/broadcom/pinmux/Kconfig
```kconfig
# Kconfig - BRCM IOMUX drvier configuration options

#
# Copyright (c) 2018 Broadcom Inc.
#
# SPDX-License-Identifier: Apache-2.0
#

#
# BRCM IOMUX driver options
#

config ALLOW_IOMUX_OVERRIDE
	bool "Allow application to override pinmux setting after init"
	default n
	help
		Setting this flag allows the application to override a
		previously configrued iomux setting. By default this is
		set to 'n', so that there are no accidental overriding
		of an MFIO function. This flag is made available for
		testing purposes only.
```

## drivers/broadcom/sc/Kconfig
```kconfig
# Kconfig - BRCM Smart card drvier configuration options

#
# Copyright (c) 2018 Broadcom Inc.
#
# SPDX-License-Identifier: Apache-2.0
#

#
# BRCM Smart card driver options
#

config EMVCO_TEST
	bool "Enable EMVCo test"
	default n
	depends on BRCM_DRIVER_SCC
	select UART_LINE_CTRL
	select UART_NS16550_LINE_CTRL
	select UART_CONSOLE_DEBUG_SERVER_HOOKS
	help
		Enable EMVCo test
```

## drivers/broadcom/smau/Kconfig
```kconfig
# Kconfig - BRCM SMAU drvier configuration options

#
# Copyright (c) 2018 Broadcom Inc.
#
# SPDX-License-Identifier: Apache-2.0
#

#
# BRCM SMAU driver options
#

config MIN_SMAU_WINDOW_SIZE
	hex
	# Omit prompt to signify "hidden" option
	default 0x100000
	depends on BRCM_DRIVER_SMAU
	help
		Minimum SMAU window size allowed to be configured
```

## drivers/broadcom/unicam/Kconfig
```kconfig
# Kconfig - BRCM Unicam drvier configuration options

#
# Copyright (c) 2018 Broadcom Inc.
#
# SPDX-License-Identifier: Apache-2.0
#

#
# BRCM Unicam driver options

config USE_STATIC_MEMORY_FOR_BUFFER
	bool
	default y
	depends on BRCM_DRIVER_UNICAM
	help
	  Enable usage of statically allocated memory for image
	  buffers.

# Select one of the three unicam physical interfaces supported
config UNICAM_PHYS_INTERFACE_CSI
	bool "Select the CSI 2 (MIPI) camera interface"
	default y
	depends on BRCM_DRIVER_UNICAM
	help
	  Choose csi-2 physical interface for unicam

config UNICAM_PHYS_INTERFACE_CCP
	bool "Select the CCP2 (Serial) camera interface"
	default n
	depends on BRCM_DRIVER_UNICAM
	help
	  Choose ccp-2 physical interface for unicam

config UNICAM_PHYS_INTERFACE_CPI
	bool "Select the CPI (Parallel) camera interface"
	default n
	depends on BRCM_DRIVER_UNICAM
	help
	  Choose cpi physical interface for unicam

config CAM_I2C_PORT
	int "Select which I2C port is used for camera control"
	default 1
	depends on BRCM_DRIVER_UNICAM
	help
	  Select which I2C port number controls camera, SVK = 1, SERP = 0

# Camera module option - Select one
config LI_V024M_CAMERA
	bool "Select Leopard Imaging's V024M camera"
	default y
	depends on BRCM_DRIVER_UNICAM
	help
	  Choose Leopard imaging's V024M camera module
```

## drivers/broadcom/usbd/Kconfig
```kconfig
# Kconfig - USB device configuration options

#
# Copyright (c) 2018 Broadcom Inc.
#
# SPDX-License-Identifier: Apache-2.0
#

if BRCM_DRIVER_USBD

config SYS_LOG_USBD_DRIVER_LEVEL
	int
	prompt "USB driver log level"
	depends on SYS_LOG
	default 2
	help
	Sets log level for USB driver

	Levels are:

	- 0 OFF, do not write

	- 1 ERROR, only write SYS_LOG_ERR

	- 2 WARNING, write SYS_LOG_WRN in addition to previous level

	- 3 INFO, write SYS_LOG_INF in addition to previous levels

	- 4 DEBUG, write SYS_LOG_DBG in addition to previous levels

endif # BRCM_DRIVER_USBD
```

## dts/bindings/brcm/arm,cortexa-timer.yaml
```yaml
---
title: ARM CORTEX A TIMER
version: 0.1

description: >
    This binding gives a base representation of the ARM CORTEX A TIMER

properties:
    compatible:
      type: string
      category: required
      description: compatible strings
      constraint: "arm,cortexa-timer"

    interrupts:
      type: array
      category: required
      description: required interrupts
      generation: define
...
```

## dts/bindings/brcm/arm,gic.yaml
```yaml
---
title: ARM Generic Interrupt Controller (GIC)
version: 0.1

description: >
    This binding describes the ARM GIC interrupt controller

properties:
    compatible:
      category: required
      type: string
      description: compatible strings
      constraint: "arm,gic"

    reg:
      category: required
      type: int
      description: mmio register space
      generation: define

    arm,num-irqs:
      category: required
      type: int
      description: number of irq inputs the GIC handles
      generation: define

cell_string: IRQ

"#cells":
  - type
  - irq
...
```
