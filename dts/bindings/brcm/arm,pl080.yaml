## dts/bindings/brcm/arm,pl080.yaml
```yaml
---
title: ARM PL080 DMA CONTROLLER
version: 0.1

description: >
    This binding gives a base representation of the ARM PL080 DMA CONTROLLER

properties:
    compatible:
      type: string
      category: required
      description: compatible strings
      constraint: "arm,pl080"

    reg:
      type: array
      category: required
      description: mmio register space
      generation: define

    interrupts:
      type: array
      category: required
      description: required interrupts
      generation: define

    dma-channels:
      type: int
      category: required
      description: number of DMA channels present
      generation: define

...
```

## dts/bindings/brcm/arm,smc.yaml
```yaml
---
title: ARM PL352 Static Memory Controller
version: 0.1

description: >
    This binding describes a base representation of the ARM PL352 SMC Controller

properties:
    compatible:
      category: required
      type: string
      description: compatible strings
      constraint: "arm,smc-pl352"

    reg:
      category: required
      type: int
      description: mmio register space
      generation: define

...
```

## dts/bindings/brcm/arm,sp804-timer.yaml
```yaml
---
title: ARM SP804 TIMER
version: 0.1

description: >
    This binding gives a base representation of the ARM SP804 TIMER

properties:
    compatible:
      type: string
      category: required
      description: compatible strings
      constraint: "arm,sp804-timer"

    reg:
      type: array
      description: mmio register space
      generation: define
      category: required

    interrupts:
      type: array
      category: required
      description: required interrupts
      generation: define
...
```

## dts/bindings/brcm/arm,sp805.yaml
```yaml
---
title: SP805 Watchdog Timer register map
version: 0.1

description: >
    This binding describes the ARM SP805 Watchdog Timer registers

properties:
    compatible:
      category: required
      type: string
      description: compatible strings
      constraint: "arm,sp805"

    reg:
      category: required
      type: int
      description: mmio register space
      generation: define

    interrupts:
      category: required
      type: array
      description: required interrupts
      generation: define

...
```

## dts/bindings/brcm/brcm,cit-aon-gpio.yaml
```yaml
---
title: Broadcom AON GPIO Controller register map
version: 0.1

description: >
    This binding describes the Broadcom AON GPIO controller registers

properties:
    compatible:
      category: required
      type: string
      description: compatible strings
      constraint: "brcm,cit-aon-gpio"

    reg:
      category: required
      type: array
      description: mmio register space
      generation: define

...
```

## dts/bindings/brcm/brcm,cit-armpll.yaml
```yaml
---
title: Broadcom ARM PLL Clocks
version: 0.1

description: >
    This binding describes the Broadcom ARM PLL Clocks

properties:
    compatible:
      category: required
      type: string
      description: compatible strings
      constraint: "brcm,cit-armpll"

    reg:
      category: required
      type: int
      description: mmio register space
      generation: define

...
```

## dts/bindings/brcm/brcm,cit-bbl.yaml
```yaml
---
title: Broadcom BBL interrupts map
version: 0.1

description: >
    This binding describes the Broadcom BBL interrupts

properties:
    compatible:
      category: required
      type: string
      description: compatible strings
      constraint: "brcm,cit-bbl"

    interrupts:
      type: array
      category: required
      description: required interrupts
      generation: define

...
```

## dts/bindings/brcm/brcm,cit-chip-dru.yaml
```yaml
---
title: Broadcom CHIP DRU (Device Resource Unit)
version: 0.1

description: >
    This binding describes the Broadcom CHIP DRU

properties:
    compatible:
      category: required
      type: string
      description: compatible strings
      constraint: "brcm,cit-chip-dru"

    reg:
      category: required
      type: int
      description: mmio register space
      generation: define

...
```

## dts/bindings/brcm/brcm,cit-crmu-dru.yaml
```yaml
---
title: Broadcom CRMU DRU (Device Resource Unit)
version: 0.1

description: >
    This binding describes the Broadcom CRMU DRU

properties:
    compatible:
      category: required
      type: string
      description: compatible strings
      constraint: "brcm,cit-crmu-dru"

    reg:
      category: required
      type: int
      description: mmio register space
      generation: define

...
```

## dts/bindings/brcm/brcm,cit-dmu.yaml
```yaml
---
title: Broadcom DMU (Device Management Unit) Common Registers
version: 0.1

description: >
    This binding describes the Broadcom DMU

properties:
    compatible:
      category: required
      type: string
      description: compatible strings
      constraint: "brcm,cit-dmu"

    reg:
      category: required
      type: int
      description: mmio register space
      generation: define

...
```

## dts/bindings/brcm/brcm,cit-dpa.yaml
```yaml
---
title: Broadcom DPA register map
version: 0.1

description: >
    This binding describes the Broadcom DPA registers

properties:
    compatible:
      category: required
      type: string
      description: compatible strings
      constraint: "brcm,cit-dpa"

    reg:
      category: required
      type: int
      description: mmio register space
      generation: define

...
```

## dts/bindings/brcm/brcm,cit-gpio.yaml
```yaml
---
title: Broadcom GPIO Controller register map
version: 0.1

description: >
    This binding describes the Broadcom GPIO controller registers

properties:
    compatible:
      category: required
      type: string
      description: compatible strings
      constraint: "brcm,cit-gpio"

    reg:
      category: required
      type: array
      description: mmio register space
      generation: define

    interrupts:
      type: array
      category: required
      description: required interrupts
      generation: define

...
```

## dts/bindings/brcm/brcm,cit-i2c.yaml
```yaml
---
title: Broadcom I2C Controller
version: 0.1

description: >
    This binding describes the Broadcom I2C Nodes

properties:
    compatible:
      category: required
      type: string
      description: compatible strings
      constraint: "brcm,cit-i2c"

    reg:
      category: required
      type: int
      description: mmio register space
      generation: define

...
```

## dts/bindings/brcm/brcm,cit-nfc-gpio.yaml
```yaml
---
title: Broadcom NFC GPIO register map
version: 0.1

description: >
    This binding describes the Broadcom IOSYS GPIO controller registers

properties:
    compatible:
      category: required
      type: string
      description: compatible strings
      constraint: "brcm,cit-iosys-gpio"

    reg:
      category: required
      type: array
      description: mmio register space
      generation: define

...
```

## dts/bindings/brcm/brcm,cit-otpc.yaml
```yaml
---
title: Broadcom OTP Controller register map
version: 0.1

description: >
    This binding describes the Broadcom OTP controller registers

properties:
    compatible:
      category: required
      type: string
      description: compatible strings
      constraint: "brcm,cit-otpc"

    reg:
      category: required
      type: int
      description: mmio register space
      generation: define

...
```

## dts/bindings/brcm/brcm,cit-pka.yaml
```yaml
---
title: Broadcom PKA hardware map
version: 0.1

description: >
    This binding describes the Broadcom PKA controller registers

properties:
    compatible:
      category: required
      type: string
      description: compatible strings
      constraint: "brcm,cit-pka"

    reg:
      category: required
      type: int
      description: mmio register space
      generation: define

...
```

## dts/bindings/brcm/brcm,cit-pwm.yaml
```yaml
---
title: Broadcom PWM Controller
version: 0.1

description: >
    This binding describes the Broadcom PWM Nodes

properties:
    compatible:
      category: required
      type: string
      description: compatible strings
      constraint: "brcm,cit-pwm"

    reg:
      category: required
      type: int
      description: mmio register space
      generation: define

...
```

## dts/bindings/brcm/brcm,cit-qspi.yaml
```yaml
---
title: Broadcom QSPI Controller memory maps
version: 0.1

description: >
    This binding describes the Broadcom QSPI controller memory mapped regions

properties:
    compatible:
      category: required
      type: string
      description: compatible strings
      constraint: "brcm,cit-qspi"

    reg:
      category: required
      type: int
      description: mmio register space
      generation: define

...
```

## dts/bindings/brcm/brcm,cit-rng.yaml
```yaml
---
title: Broadcom RNG hardware map
version: 0.1

description: >
    This binding describes the Broadcom RNG hardware registers

properties:
    compatible:
      category: required
      type: string
      description: compatible strings
      constraint: "brcm,cit-rng"

    reg:
      category: required
      type: int
      description: mmio register space
      generation: define

...
```

## dts/bindings/brcm/brcm,cit-scc.yaml
```yaml
---
title: Broadcom Smart card Controller
version: 0.1

description: >
    This binding describes the Broadcom Smart card controller Nodes

properties:
    compatible:
      category: required
      type: string
      description: compatible strings
      constraint: "brcm,cit-scc"

    reg:
      category: required
      type: int
      description: mmio register space
      generation: define

...
```

## dts/bindings/brcm/brcm,cit-smau.yaml
```yaml
---
title: Broadcom SMAU Controller register map
version: 0.1

description: >
    This binding describes the Broadcom SMAU (secure memory access unit)
    controller registers

properties:
    compatible:
      category: required
      type: string
      description: compatible strings
      constraint: "brcm,cit-smau"

    reg:
      category: required
      type: int
      description: mmio register space
      generation: define

...
```

## dts/bindings/brcm/brcm,cit-sotp.yaml
```yaml
---
title: Broadcom SOTP Controller register map
version: 0.1

description: >
    This binding describes the Broadcom SOTP controller registers

properties:
    compatible:
      category: required
      type: string
      description: compatible strings
      constraint: "brcm,cit-sotp"

    reg:
      category: required
      type: int
      description: mmio register space
      generation: define

...
```

## dts/bindings/brcm/brcm,cit-spi.yaml
```yaml
---
title: Broadcom SPI Controller register map
version: 0.1

description: >
    This binding describes the Broadcom SPI controller registers

properties:
    compatible:
      category: required
      type: string
      description: compatible strings
      constraint: "brcm,cit-spi"

    reg:
      category: required
      type: int
      description: mmio register space
      generation: define

    interrupts:
      type: array
      category: required
      description: required interrupts
      generation: define

...
```

## dts/bindings/brcm/brcm,cit-spl.yaml
```yaml
---
title: Broadcom Secure Protection Logic
version: 0.1

description: >
    This binding describes the Broadcom Secure Protection Logic

properties:
    compatible:
      category: required
      type: string
      description: compatible strings
      constraint: "brcm,cit-spl"

    reg:
      category: required
      type: int
      description: mmio register space
      generation: define

    interrupts:
      type: array
      category: required
      description: required interrupts
      generation: define

...
```

## dts/bindings/brcm/brcm,cit-spru.yaml
```yaml
---
title: Broadcom SPRU Indirect register access interface registers
version: 0.1

description: >
    This binding describes the Broadcom SPRU

properties:
    compatible:
      category: required
      type: string
      description: compatible strings
      constraint: "brcm,cit-spru"

    reg:
      category: required
      type: int
      description: mmio register space
      generation: define

...
```
