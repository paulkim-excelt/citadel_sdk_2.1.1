## dts/bindings/brcm/brcm,cit-unicam.yaml
```yaml
---
title: Broadcom UNICAM Controller register map
version: 0.1

description: >
    This binding describes the Broadcom UNICAM controller registers

properties:
    compatible:
      category: required
      type: string
      description: compatible strings
      constraint: "brcm,cit-unicam"

    reg:
      category: required
      type: int
      description: mmio register space
      generation: define

    interrupts:
      type: array
      category: required
      description: required interrupts
      generation: define

...
```

## dts/bindings/brcm/brcm,cit-usbd.yaml
```yaml
---
title: Broadcom USB Device Controller register map
version: 0.1

description: >
    This binding describes the Broadcom USB Device controller registers

properties:
    compatible:
      category: required
      type: string
      description: compatible strings
      constraint: "brcm,cit-usbd"

    reg:
      category: required
      type: int
      description: mmio register space
      generation: define

    interrupts:
      type: array
      category: required
      description: required interrupts
      generation: define

...
```

## soc/arm/brcm_bcm5820x/Kconfig
```kconfig
# Kconfig - BCM5820X platform configuration options

#
# Copyright (c) 2017 Broadcom Limited
#
# SPDX-License-Identifier: Apache-2.0
#

if SOC_BCM5820X

config RAM_RESERVED_FOR_POWER_MGMT
	int
	# Omit prompt to signify "hidden" option
	default 64
	help
	This config flag specifies the RAM reserved for use by the boot loader
	when the system supports low power mode enter/exit. This memory is expected
	to be used by the boot loader and will not be preserved after a deep
	sleep enter/exit sequence

endif # SOC_BCM5820X
```

## soc/arm/brcm_bcm5820x/Kconfig.defconfig
```kconfig
# Kconfig - BCM 5820X platform configuration options

#
# Copyright (c) 2017 Broadcom Limited
#
# SPDX-License-Identifier: Apache-2.0
#

if SOC_BCM5820X

config SOC
	default "brcm_bcm5820x"

config SYS_CLOCK_HW_CYCLES_PER_SEC
	int
	default 200000000

endif # SOC_BCM5820X
```

## soc/arm/brcm_bcm5820x/Kconfig.soc
```kconfig
config SOC_BCM5820X
	bool "Broadcom 5820X"
	select CPU_HAS_FPU
	select ARM_CORE_MMU
	select CORTEX_A_TIMER
	select ARM_GIC_400
	select CPU_CORTEX_A7
	select CPU_CORTEX_A
	select BOOT_LOADER_IN_ARM_STATE
```

## subsys/zbar-0.10/Kconfig
```kconfig
# Kconfig - QRcode decoder configuration options
# 
#
# Copyright (c) 2018 Broadcom Inc.
#
# SPDX-License-Identifier: Apache-2.0
#

config ZBAR
	bool
	prompt "Enable zbar to decode QRcode"
	default n
	help
	Use simplified zbar-0.10 to decode QRcode

if ZBAR
config ZBAR_USE_STATIC_BUFFER
	bool
	prompt "Use static memory for ZBAR internal buffers"
	default n
	help
	  Use static memory in ZBAR decoder

config ZBAR_DEBUG
	bool
	default y
	help
	  Enable ZBAR debug messages

# Including zbar unit test config flags here
config ZBAR_STATIC_TEST
	bool
	prompt "Enable zbar unit tests"
	default n
	help
	  Enable ZBAR unit test

endif

if ZBAR_STATIC_TEST
config ZBAR_STATIC_TEST_Y800
	bool
	default y
	help
	  Enable Y8 image decoding unit test

config ZBAR_STATIC_TEST_YUY2
	bool
	default y
	help
	  Enable YUY2 image decoding unit test
endif
```
